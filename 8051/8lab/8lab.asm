$NOMOD51; директива подавляет предварительное определение имен 8051 SFR
$include (C8051F120.inc); подключение библиотеки микропроцессорного семейства "C8051F120"

SW_SHD EQU 30h; «тень» состояния кнопки SW, подключенной к выводу P3.7  
LED BIT P1.6; указание на светодиод, подключенный к выводу P1.6
	
CSEG AT 0; определяет начало сегмента программы (в нашем случае 0)
LJMP MAIN; передача управления по адресу MAIN

Reset_Sources_Init: отключение сторожевого таймера
    mov  WDTCN,     #0DEh; 
    mov  WDTCN,     #0ADh
    ret

PCA_Init: ;работа с ПМС
    mov  SFRPAGE,   #PCA0_PAGE
    mov  PCA0CN,    #040h; включение ПМС
    mov  PCA0CPM4,  #042h;  установки ПМС в режим 8-разрядного ШИМ
    ret

Port_IO_Init:
    mov  SFRPAGE,   #CONFIG_PAGE
    mov  P1MDOUT,   #040h; задание двухтактного выхода p1.6 (Push-pull output):
    mov  XBR0,      #2Fh
    mov  XBR2,      #044h
    ret


Init_Device:
    lcall Reset_Sources_Init
    lcall PCA_Init
    lcall Port_IO_Init
    ret
	
MAIN:
	CALL Init_Device; инициализация устройства
	CLR LED; выключение светодиода					
	;	
	mov	A,P3; пробное чтение состояния						
	anl	A,#80h; кнопки SW, подключенной к выводу P3.7  
	mov	SW_SHD,A; сохранение в «тени»
	
PWM:			
	mov	R7, #08h; задание номера значения длительностей импульсов (он же – число значений яркости)									

Loop0:	mov	A,P3						
	anl	A,#80h;
	cjne A,SW_SHD,SKIP; проверка изменения состояния, если кнопка нажата, то прыгаем на метку skip
	sjmp Loop0; иначе возвращаемся на метку loop0
SKIP: mov SW_SHD,A; запоминаем новое состояние кнопки					
	JNC	Loop0; проверка была ли именно нажата кнопка, если да, то продолжаем, если нет, то прыгаем на метку loop0
	;
	mov	A,R7; записываем в А номер значения длительности импульсов 		
	acall TABLE; чтение очередного значения длительностей импульсов 
	mov  SFRPAGE,   #PCA0_PAGE; строчка нужна, чтобы можно было что-то записать в регистр PCA0CPH4
	mov	PCA0CPH4,A; устанавливаем скважность ШИМ	
	djnz R7,Loop0; вычитаем единицу из номера значения длительности импульсов, если она равна нулю, то переходим на метку PWM
	;
	jmp		PWM

TABLE: movc	A,@A+PC; возвращаемое значение длительности импульсов ШИМ								
	ret													
	DB 02h, 04h, 08h, 10h, 20h, 40h, 80h, 0FEh; таблица (массив значений яркости)
		
end
